## Config.in
```kconfig
source "$BR2_EXTERNAL_VBOX_BUILDROOT_VAGRANT_PATH/package/phpmyadmin/Config.in"
source "$BR2_EXTERNAL_VBOX_BUILDROOT_VAGRANT_PATH/package/vbox-ga/Config.in"
source "$BR2_EXTERNAL_VBOX_BUILDROOT_VAGRANT_PATH/package/mlb/Config.in"
```

## configs/vbox-lamp-vagrant_defconfig
```kconfig
BR2_CCACHE=y
BR2_TOOLCHAIN_BUILDROOT_GLIBC=y
BR2_GLIBC_VERSION_2_22=y
BR2_BINUTILS_VERSION_2_25_X=y
BR2_GCC_VERSION_5_X=y
BR2_TOOLCHAIN_BUILDROOT_CXX=y
BR2_GCC_ENABLE_LTO=y
BR2_GCC_ENABLE_GRAPHITE=y
BR2_ECLIPSE_REGISTER=y
BR2_TARGET_GENERIC_HOSTNAME="buildroot-vbox"
BR2_ROOTFS_DEVICE_TABLE="system/device_table.txt $(BR2_EXTERNAL)/board/xenogenesi/vbox-vagrant/device_table.txt"
BR2_SYSTEM_DHCP="eth0"
BR2_ROOTFS_USERS_TABLES="$(BR2_EXTERNAL)/board/xenogenesi/vbox-vagrant/user_table.txt"
BR2_ROOTFS_OVERLAY="$(BR2_EXTERNAL)/board/xenogenesi/vbox-vagrant/rootfs_overlay"
BR2_ROOTFS_POST_BUILD_SCRIPT="$(BR2_EXTERNAL)/board/xenogenesi/vbox-vagrant/post_build.sh"
BR2_ROOTFS_POST_IMAGE_SCRIPT="$(BR2_EXTERNAL)/board/xenogenesi/vbox-vagrant/post_image.sh"
BR2_LINUX_KERNEL=y
BR2_LINUX_KERNEL_USE_CUSTOM_CONFIG=y
BR2_LINUX_KERNEL_CUSTOM_CONFIG_FILE="$(BR2_EXTERNAL)/board/xenogenesi/vbox-vagrant/linux-lamp.config"
BR2_PACKAGE_BUSYBOX_CONFIG="$(BR2_EXTERNAL)/board/xenogenesi/vbox-vagrant/busybox-lamp.config"
BR2_PACKAGE_BUSYBOX_SHOW_OTHERS=y
BR2_PACKAGE_OPENSSH=y
BR2_PACKAGE_SUDO=y
BR2_PACKAGE_GETENT=y
BR2_PACKAGE_VBOX_GA=y
```

## configs/vbox-vagrant_defconfig
```kconfig
BR2_x86_i686=y
BR2_DL_DIR="$(HOME)/src/br2-dl"
BR2_CCACHE=y
BR2_TOOLCHAIN_EXTERNAL=y
BR2_TOOLCHAIN_EXTERNAL_CUSTOM=y
BR2_TOOLCHAIN_EXTERNAL_PATH="$(HOME)/x-tools/i686-xg-linux-gnu"
BR2_TOOLCHAIN_EXTERNAL_CUSTOM_PREFIX="i686-xg-linux-gnu"
BR2_TOOLCHAIN_EXTERNAL_GCC_6=y
BR2_TOOLCHAIN_EXTERNAL_HEADERS_4_4=y
BR2_TOOLCHAIN_EXTERNAL_CUSTOM_GLIBC=y
BR2_TOOLCHAIN_EXTERNAL_CXX=y
BR2_TARGET_GENERIC_HOSTNAME="buildroot-vbox"
BR2_ROOTFS_DEVICE_TABLE="system/device_table.txt $(BR2_EXTERNAL_VBOX_BUILDROOT_VAGRANT_PATH)/board/xenogenesi/vbox-vagrant/device_table.txt"
BR2_SYSTEM_DHCP="eth0"
BR2_ROOTFS_USERS_TABLES="$(BR2_EXTERNAL_VBOX_BUILDROOT_VAGRANT_PATH)/board/xenogenesi/vbox-vagrant/user_table.txt"
BR2_ROOTFS_OVERLAY="$(BR2_EXTERNAL_VBOX_BUILDROOT_VAGRANT_PATH)/board/xenogenesi/vbox-vagrant/rootfs_overlay"
BR2_ROOTFS_POST_BUILD_SCRIPT="$(BR2_EXTERNAL_VBOX_BUILDROOT_VAGRANT_PATH)/board/xenogenesi/vbox-vagrant/post_build.sh"
BR2_ROOTFS_POST_IMAGE_SCRIPT="$(BR2_EXTERNAL_VBOX_BUILDROOT_VAGRANT_PATH)/board/xenogenesi/vbox-vagrant/post_image.sh"
BR2_LINUX_KERNEL=y
BR2_LINUX_KERNEL_USE_CUSTOM_CONFIG=y
BR2_LINUX_KERNEL_CUSTOM_CONFIG_FILE="$(BR2_EXTERNAL_VBOX_BUILDROOT_VAGRANT_PATH)/board/xenogenesi/vbox-vagrant/linux.config"
BR2_PACKAGE_BUSYBOX_CONFIG="$(BR2_EXTERNAL_VBOX_BUILDROOT_VAGRANT_PATH)/board/xenogenesi/vbox-vagrant/busybox.config"
BR2_PACKAGE_BUSYBOX_SHOW_OTHERS=y
BR2_PACKAGE_OPENSSH=y
BR2_PACKAGE_SUDO=y
BR2_PACKAGE_GETENT=y
BR2_TARGET_ROOTFS_SQUASHFS=y
BR2_TARGET_ROOTFS_SQUASHFS4_XZ=y
BR2_PACKAGE_HOST_SQUASHFS=y
BR2_PACKAGE_VBOX_GA=y
BR2_PACKAGE_MLB=y
```

## package/mlb/Config.in
```kconfig
config BR2_PACKAGE_MLB
        bool "minimal linux bootloader"
        help
          Minimal Linux Bootloader, adapted/adopted from Sebastian Plotz.
          xxd and nasm are required.
          see https://youtu.be/gHi0CdEqjqw

          https://github.com/xenogenesi/mlb
```

## package/phpmyadmin/Config.in
```kconfig
config BR2_PACKAGE_PHPMYADMIN
        bool "phpmyadmin"
        help
          PHP web frontend to handle MySQL database administration

          https://www.phpmyadmin.net
```

## package/vbox-ga/Config.in
```kconfig
config BR2_PACKAGE_VBOX_GA
        bool "vbox guest additions"
        help
          VirtualBox Guest Additions, modules vboxguest and vboxsf
          and the command mount.vboxsf (needed for features like
          shared directories and others).
          vbox guest additions needs a Linux kernel to be built
          require modules support on kernel config and mount helpers
          in busybox mount options

          https://www.virtualbox.org
```
